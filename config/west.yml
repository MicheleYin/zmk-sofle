## config/west.yml
```yaml
manifest:
  remotes:
    - name: zmkfirmware
      url-base: https://github.com/zmkfirmware
  projects:
    - name: eyelash_sofle
      url: https://github.com/MicheleYin/zmk-sofle
      revision: main
    - name: zmk
      url: https://github.com/MicheleYin/zmk.git
      revision: feature/nice-view
      import: app/west.yml
    - name: zmk-module-svg
      url: https://github.com/MicheleYin/zmk-module-svg
      revision: feature/山水
  self:
    path: config
```
